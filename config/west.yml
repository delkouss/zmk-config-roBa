## config/west.yml
```yaml
manifest:
  remotes:
    - name: delkouss
      url-base: https://github.com/delkouss
    - name: kumamuk-git
      url-base: https://github.com/kumamuk-git
  projects:
    - name: zmk
      remote: delkouss
      revision: v0.3-branch
      import: app/west.yml
    - name: zmk-pmw3610-driver
      remote: kumamuk-git
      revision: main
  self:
    path: config
```
